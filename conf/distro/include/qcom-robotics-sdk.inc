## conf/layer.conf
```bitbake
BBFILES += "${LAYERDIR}/recipes/*/*.bb \
            ${LAYERDIR}/recipes/*/*.bbappend \
            ${LAYERDIR}/recipes/*/*/*.bb \
            ${LAYERDIR}/recipes/*/*/*.bbappend \
            ${LAYERDIR}/recipes-*/*/*.bb \
            ${LAYERDIR}/recipes-*/*/*.bbappend \
            ${LAYERDIR}/recipes-*/*.bb \
            ${LAYERDIR}/recipes-*/*.bbappend \
            ${LAYERDIR}/recipes/*/*/*/*.bb \
            ${LAYERDIR}/recipes-*/*/*/*.bb \
            ${LAYERDIR}/recipes-*/*/*/*.bbappend \
"

BBPATH .= ":${LAYERDIR}"
BBFILE_COLLECTIONS += "meta-qcom-robotics-sdk"
BBFILE_PRIORITY_meta-qcom-robotics-sdk = "13"
BBFILE_PATTERN_meta-qcom-robotics-sdk := "^${LAYERDIR}/"
LAYERSERIES_COMPAT_meta-qcom-robotics-sdk = "wrynose"

QRB_ROS_SAMPLE_REV = "08da75d9952ba5d256c55a3773ed58031b187896"

ros_base_prefix = "/usr/ros/${ROS_DISTRO}"
ROS_UNRESOLVED_DEP-libnanoflann-dev:forcevariable = "nanoflann"

ROBIOTICS_LAYER_DIR = "${LAYERDIR}"
COMMON_LICENSE_DIR = "${COREBASE}/meta/files/common-licenses"

ROBOTICS_PACKAGEGROUP_LIST_DIR = "${DEPLOY_DIR}/packagegroup-lists/${MACHINE_ARCH}"
```
